&i2c0 {
	status = "okay";
	/* Both RTCs disabled by default, choose one */
	pcf85063: pcf85063@51 {
		status = "disabled";
		compatible = "nxp,pcf85063";
		reg = <0x51>;
	};
	isl12022: isl12022@68 {
		status = "disabled";
		compatible = "isil,isl12022";
		reg = <0x6f>;
	};
};